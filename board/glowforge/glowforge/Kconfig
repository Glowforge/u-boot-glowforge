## board/glowforge/glowforge/Kconfig
```kconfig
if TARGET_GLOWFORGE

config SYS_BOARD
	default "glowforge"

config SYS_VENDOR
	default "glowforge"

config SYS_SOC
	default "mx6"

config SYS_CONFIG_NAME
	default "glowforge"

endif
```

## configs/glowforge_defconfig
```kconfig
CONFIG_ARM=y
CONFIG_TARGET_GLOWFORGE=y
CONFIG_SYS_EXTRA_OPTIONS="IMX_CONFIG=board/glowforge/glowforge/glowforge.cfg,MX6DL,EMMC"
# CONFIG_CMD_IMLS is not set
# CONFIG_CMD_FLASH is not set
CONFIG_DM=y
CONFIG_DM_THERMAL=y
CONFIG_NET=n
CONFIG_CMD_NET=n
CONFIG_CMD_NFS=n
CONFIG_CMD_FPGA=n
CONFIG_CMD_XIMG=n
CONFIG_CMD_IMI=n
CONFIG_CMD_IMLS=n
```
